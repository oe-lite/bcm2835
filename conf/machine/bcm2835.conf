## conf/machine/bcm2835.conf
```bitbake
MACHINE_USE_kernel_imagetype = "Image"
MACHINE_USE_netbase_auto_if = "lo eth0"
MACHINE_USE_busybox_inittab_login = "::respawn:/sbin/getty 115200 /dev/ttyAMA0 vt100"
#MACHINE_USE_busybox_watchdog_dev = "/dev/watchdog0"

MACHINE_CPU	= "arm-1176jzfs"
MACHINE_ABI	= "hard"
```
